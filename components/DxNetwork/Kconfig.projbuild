## components/DxNetwork/Kconfig.projbuild
```kconfig
menu "Provisioning Configuration"

    config DXNETWORK_USE_EVENT_API_CXX
            bool
            default n
            prompt "Event loop use Event API for C++"
            help
                This config depends on DxSystem. If you don't have the code, select no (disabled)

    choice DXNETWORK_PROV_TRANSPORT
        bool "Provisioning Transport"
        default DXNETWORK_PROV_TRANSPORT_SOFTAP if IDF_TARGET_ESP32S2
        default DXNETWORK_PROV_TRANSPORT_BLE
        help
            Wi-Fi provisioning component offers both, SoftAP and BLE transports. Choose any one.

        config DXNETWORK_PROV_TRANSPORT_BLE
            bool "BLE"
            select BT_ENABLED
            depends on !IDF_TARGET_ESP32S2
        config DXNETWORK_PROV_TRANSPORT_SOFTAP
            bool "Soft AP"
    endchoice

    config DXNETWORK_PROV_TRANSPORT
        int
        default 1 if DXNETWORK_PROV_TRANSPORT_BLE
        default 2 if DXNETWORK_PROV_TRANSPORT_SOFTAP

    config DXNETWORK_RESET_PROVISIONED
        bool
        default n
        prompt "Reset provisioned status of the device"
        help
            This erases the NVS to reset provisioned status of the device on every reboot.
            Provisioned status is determined by the Wi-Fi STA configuration, saved on the NVS.

    config DXNETWORK_RESET_PROV_MGR_ON_FAILURE
        bool
        default y
        prompt "Reset provisioned credentials and state machine after session failure"
        help
            Enable reseting provisioned credentials and state machine after session failure.
            This will restart the provisioning service after retries are exhausted.

    config DXNETWORK_PROV_MGR_MAX_RETRY_CNT
        int
        default 5
        prompt "Max retries before reseting provisioning state machine"
        depends on DXNETWORK_RESET_PROV_MGR_ON_FAILURE
        help
            Set the Maximum retry to avoid reconnecting to an inexistent AP or if credentials
            are misconfigured. Provisioned credentials are erased and internal state machine
            is reset after this threshold is reached.

    config DXNETWORK_PROV_SHOW_QR
        bool "Show provisioning QR code"
        default y
        help
            Show the QR code for provisioning.

    config DXNETWORK_PROV_USING_BLUEDROID
        bool
        depends on (BT_BLUEDROID_ENABLED && (IDF_TARGET_ESP32C3 || IDF_TARGET_ESP32S3))
        select BT_BLE_42_FEATURES_SUPPORTED
        default y
        help
            This enables BLE 4.2 features for Bluedroid.
endmenu
```
